## boards/arm/bluemicro840_v1/Kconfig.board
```kconfig
# BlueMicro840 v1 board configuration

config BOARD_BLUEMICRO840_V1
    bool "BlueMicro840 v1"
    depends on SOC_NRF52840_QIAA
```

## boards/arm/bluemicro840_v1/Kconfig.defconfig
```kconfig
# Copyright (c) 2024 The ZMK Contributors
# SPDX-License-Identifier: MIT

if BOARD_BLUEMICRO840_V1

config BOARD
    default "bluemicro840_v1"

config BT_CTLR
    default BT

config ZMK_BLE
    default y

config ZMK_USB
    default y

config ZMK_BATTERY_VOLTAGE_DIVIDER
    default y

config SPI
    default y

config I2C
    default y

endif # BOARD_BLUEMICRO840_V1
```

## boards/arm/bluemicro840_v1/bluemicro840_v1_defconfig
```kconfig
# SPDX-License-Identifier: MIT

CONFIG_SOC_SERIES_NRF52X=y
CONFIG_SOC_NRF52840_QIAA=y
CONFIG_BOARD_BLUEMICRO840_V1=y

# Enable MPU
CONFIG_ARM_MPU=y

# Enable hardware stack protection
CONFIG_HW_STACK_PROTECTION=y

# Enable RTT
CONFIG_USE_SEGGER_RTT=y

# Enable GPIO
CONFIG_GPIO=y

# Enable UART
CONFIG_SERIAL=y

# Enable console
CONFIG_CONSOLE=y
CONFIG_UART_CONSOLE=y

# Enable USB
CONFIG_USB_DEVICE_STACK=y
CONFIG_USB_DEVICE_MANUFACTURER="BlueMicro"
CONFIG_USB_DEVICE_PRODUCT="BlueMicro840 v1"
CONFIG_USB_DEVICE_VID=0x1D50
CONFIG_USB_DEVICE_PID=0x615E

# Enable I2C
CONFIG_I2C=y
CONFIG_I2C_NRFX=y

# Enable SPI
CONFIG_SPI=y
CONFIG_SPI_NRFX=y

# Enable battery voltage divider
CONFIG_ADC=y
CONFIG_ZMK_BATTERY_VOLTAGE_DIVIDER=y

# Additional board options
CONFIG_GPIO_AS_PINRESET=y

# Build UF2 by default
CONFIG_BUILD_OUTPUT_UF2=y
```

## boards/arm/bluemicro840_v1_clear_bt/Kconfig.board
```kconfig
# BlueMicro840 v1 Clear BT board configuration

config BOARD_BLUEMICRO840_V1_CLEAR_BT
    bool "BlueMicro840 v1 Clear BT"
    depends on SOC_NRF52840_QIAA
```

## boards/arm/bluemicro840_v1_clear_bt/Kconfig.defconfig
```kconfig
# Copyright (c) 2024 The ZMK Contributors
# SPDX-License-Identifier: MIT

if BOARD_BLUEMICRO840_V1_CLEAR_BT

config BOARD
    default "bluemicro840_v1_clear_bt"

config BT_CTLR
    default BT

config ZMK_BLE
    default y

config ZMK_USB
    default y

endif # BOARD_BLUEMICRO840_V1_CLEAR_BT
```

## boards/arm/nice_nano_v2_clear_bt/Kconfig.board
```kconfig
config BOARD_NICE_NANO_V2_CLEAR_BT
    bool "nice!nano v2 Clear BT"
    depends on SOC_NRF52840_QIAA
    select BOARD_NICE_NANO_V2
```

## boards/arm/nice_nano_v2_clear_bt/Kconfig.defconfig
```kconfig
if BOARD_NICE_NANO_V2_CLEAR_BT

config ZMK_BLE_CLEAR_BONDS_ON_START
    default y

endif # BOARD_NICE_NANO_V2_CLEAR_BT
```

## boards/arm/nice_nano_v2_clear_bt/nice_nano_v2_clear_bt_defconfig
```kconfig
# SPDX-License-Identifier: MIT

CONFIG_SOC_SERIES_NRF52X=y
CONFIG_SOC_NRF52840_QIAA=y
CONFIG_BOARD_NICE_NANO_V2_CLEAR_BT=y

# Enable MPU
CONFIG_ARM_MPU=y

# Enable GPIO
CONFIG_GPIO=y

# Enable pinctrl
CONFIG_PINCTRL=y

# Enable UART
CONFIG_SERIAL=y
CONFIG_UART_ASYNC_API=y

# Enable console
CONFIG_CONSOLE=y
CONFIG_UART_CONSOLE=y

# Enable USB
CONFIG_USB_DEVICE_STACK=y
CONFIG_USB_DEVICE_MANUFACTURER="ZMK"
CONFIG_USB_DEVICE_PRODUCT="nice!nano v2 Clear BT"
CONFIG_USB_DEVICE_VID=0x239A
CONFIG_USB_DEVICE_PID=0x000B
CONFIG_USB_CDC_ACM=y

# Enable UF2 build
CONFIG_BUILD_OUTPUT_UF2=y

# Enable bluetooth
CONFIG_BT=y
CONFIG_BT_HCI=y
CONFIG_BT_HCI_RAW=y
CONFIG_BT_HCI_RAW_H4=y
CONFIG_BT_HCI_RAW_RESERVE=1
CONFIG_BT_MAX_CONN=5
CONFIG_BT_CTLR=y

# System optimization
CONFIG_SYSTEM_WORKQUEUE_STACK_SIZE=2048
CONFIG_MAIN_STACK_SIZE=1024
CONFIG_ISR_STACK_SIZE=1024
CONFIG_HEAP_MEM_POOL_SIZE=8192

# Code partition
CONFIG_USE_DT_CODE_PARTITION=y
```

## boards/bluemicro/bluemicro840_v1/Kconfig.bluemicro840_v1
```kconfig
# Copyright (c) 2024 The ZMK Contributors
# SPDX-License-Identifier: MIT

config BOARD_BLUEMICRO840_V1
    select SOC_NRF52840_QIAA
```

## boards/bluemicro/bluemicro840_v1_clear_bt/Kconfig.bluemicro840_v1_clear_bt
```kconfig
# Copyright (c) 2024 The ZMK Contributors
# SPDX-License-Identifier: MIT

config BOARD_BLUEMICRO840_V1_CLEAR_BT
    select SOC_NRF52840_QIAA
```

## boards/bluemicro/bluemicro840_v1_clear_bt/Kconfig.defconfig
```kconfig
# Copyright (c) 2024 The ZMK Contributors
# SPDX-License-Identifier: MIT

if BOARD_BLUEMICRO840_V1_CLEAR_BT

config BT_CTLR
    default BT

config ZMK_BLE
    default y

config ZMK_USB
    default y

endif # BOARD_BLUEMICRO840_V1_CLEAR_BT
```

## boards/bluemicro/bluemicro840_v1_clear_bt/board.yml
```yaml
board:
  name: bluemicro840_v1_clear_bt
  vendor: bluemicro
  socs:
    - name: nrf52840
```

## boards/nicekeyboards/nice_nano_v2_clear_bt/Kconfig.defconfig
```kconfig
# Copyright (c) 2024 The ZMK Contributors
# SPDX-License-Identifier: MIT

if BOARD_NICE_NANO_V2_CLEAR_BT

config BT_CTLR
    default BT

config ZMK_BLE
    default y

config ZMK_USB
    default y

endif # BOARD_NICE_NANO_V2_CLEAR_BT
```

## boards/nicekeyboards/nice_nano_v2_clear_bt/Kconfig.nice_nano_v2_clear_bt
```kconfig
# Copyright (c) 2024 The ZMK Contributors
# SPDX-License-Identifier: MIT

config BOARD_NICE_NANO_V2_CLEAR_BT
    select SOC_NRF52840_QIAA
```

## boards/nicekeyboards/nice_nano_v2_clear_bt/board.yml
```yaml
board:
  name: nice_nano_v2_clear_bt
  vendor: nicekeyboards
  socs:
    - name: nrf52840
```

## boards/nicekeyboards/nice_nano_v2_clear_bt/nice_nano_v2_clear_bt_defconfig
```kconfig
# SPDX-License-Identifier: MIT

# Enable MPU
CONFIG_ARM_MPU=y

# Enable GPIO
CONFIG_GPIO=y

# Enable pinctrl
CONFIG_PINCTRL=y

# Enable UART
CONFIG_SERIAL=y
CONFIG_UART_ASYNC_API=y

# Enable console
CONFIG_CONSOLE=y
CONFIG_UART_CONSOLE=y

# Enable USB
CONFIG_USB_DEVICE_STACK=y
CONFIG_USB_DEVICE_MANUFACTURER="ZMK"
CONFIG_USB_DEVICE_PRODUCT="nice!nano v2 Clear BT"
CONFIG_USB_DEVICE_VID=0x239A
CONFIG_USB_DEVICE_PID=0x000B
CONFIG_USB_CDC_ACM=y

# Enable UF2 build
CONFIG_BUILD_OUTPUT_UF2=y

# Code partition
CONFIG_USE_DT_CODE_PARTITION=y
```

## boards/shields/ekeeb/Kconfig.defconfig
```kconfig
# Copyright (c) 2021 The ZMK Contributors
# SPDX-License-Identifier: MIT

if SHIELD_EKEEB

config ZMK_KEYBOARD_NAME
	default "ekeeb"

config SPI
    default y

if ZMK_DISPLAY

config I2C
	default y

config SSD1306
	default y

#config SSD1306_REVERSE_MODE
#	default y

endif # ZMK_DISPLAY

if LVGL

config LV_Z_VDB_SIZE
	default 64

config LV_DPI_DEF
	default 148

config LV_Z_BITS_PER_PIXEL
	default 1

choice LVGL_COLOR_DEPTH
    bool
    default LVGL_COLOR_DEPTH_1
    #depends on LVGL && DISPLAY && (SHIELD_SSD1306_128X64 || SHIELD_SSD1306_128X64_SPI|| SHIELD_SSD1306_128X32
end choice
endif # LVGL

endif
```

## boards/shields/ekeeb/boards/nice_nano_v2.conf
```kconfig
# Uncomment both to enable underglow
#CONFIG_ZMK_RGB_UNDERGLOW=y
#CONFIG_WS2812_STRIP=y

# Connection parameters
CONFIG_BT_PERIPHERAL_PREF_MIN_INT=12
CONFIG_BT_PERIPHERAL_PREF_MAX_INT=24
CONFIG_BT_PERIPHERAL_PREF_LATENCY=30
CONFIG_BT_PERIPHERAL_PREF_TIMEOUT=400

# Enhanced stability
CONFIG_BT_BUF_ACL_RX_COUNT=8
CONFIG_BT_BUF_ACL_TX_COUNT=8
CONFIG_BT_L2CAP_TX_BUF_COUNT=8
CONFIG_BT_CTLR_RX_BUFFERS=8
CONFIG_BT_CTLR_TX_BUFFERS=8
CONFIG_BT_ATT_PREPARE_COUNT=5

# Power and PHY settings
CONFIG_BT_CTLR_TX_PWR_PLUS_8=y
CONFIG_BT_DATA_LEN_UPDATE=y
CONFIG_BT_AUTO_PHY_UPDATE=y

# System optimizations
CONFIG_SYSTEM_WORKQUEUE_STACK_SIZE=2048
CONFIG_MAIN_STACK_SIZE=2048
CONFIG_ISR_STACK_SIZE=2048
```
